#include "my_keyboard.dtsi" // The shared dtsi file is included in the overlay

&kscan0 {
    row-gpios 
        = <&pro_micro 15 (GPIO_ACTIVE_HIGH | GPIO_PULL_DOWN)>
        ;
	col-gpios
		= <&pro_micro 14 GPIO_ACTIVE_HIGH>
		;
};